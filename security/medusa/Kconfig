## security/medusa/Kconfig
```kconfig
source "security/medusa/testing/Kconfig"

config SECURITY_MEDUSA
	def_bool y
	depends on SECURITY_MEDUSA_SUPPORT
	depends on SECURITY_MEDUSA_MET_DEPENDENCIES

menuconfig SECURITY_MEDUSA_SUPPORT
	bool "MEDUSA support"
	depends on SECURITY && AUDIT
	select NETWORK_SECMARK
	default n
	help
	  This selects MEDUSA LSM.

config SECURITY_MEDUSA_MET_DEPENDENCIES
	def_bool y
	depends on SECURITY_MEDUSA_SUPPORT=y
	depends on CRYPTO_BLAKE2B=y || CRYPTO_BLAKE2S=y || CRYPTO_SHA256=y || \
		   CRYPTO_SHA512=y || CRYPTO_SHA3=y

if SECURITY_MEDUSA_SUPPORT && !SECURITY_MEDUSA_MET_DEPENDENCIES
	comment "Please  select  at least one  of the hashing functions"
	comment "(BLAKE2b, SHA-256, SHA-512, SHA-3) as _builtin_ in the"
	comment "'Cryptographic API  --->  Hashes,  digests,  and MACs'"
	comment "section and then return here to configure Medusa LSM."
endif

if SECURITY_MEDUSA_MET_DEPENDENCIES

config SECURITY_MEDUSA_VS
        int "Number of bits representing Virtual Spaces (VS)"
	# read default value from Medusa's config.h, if any; otherwise set default to 64
	default $(shell,grep -E "#define CONFIG_MEDUSA_VS [0-9]+" ./security/medusa/include/l3/config.h | grep -o -E "[0-9]+" || echo 64)
        range 32 512
        help
	  Medusa Communication Protocol transfers size of attributes in Bytes.
	  To prevent a mistake and errornous interpretation of bits out of
	  bitarray, the array size SEURITY_MEDUSA_VS must be a multiple of 8.

config SECURITY_MEDUSA_ACT
        int "Number of bits representing triggered security hooks"
	# read default value from Medusa's config.h, if any; otherwise set default to 96
	default $(shell,grep -E "#define CONFIG_MEDUSA_ACT [0-9]+" ./security/medusa/include/l3/config.h | grep -o -E "[0-9]+" || echo 96)
        range 32 512
        help
	  Medusa Communication Protocol transfers size of attributes in Bytes.
	  To prevent a mistake and errornous interpretation of bits out of
	  bitarray, the array size SEURITY_MEDUSA_ACT must be a multiple of 8.

config SECURITY_MEDUSA_L4_CONSTABLE
        tristate "MEDUSA L4 as MODULE"
        default y
        help
          Compiles l4 on medusa as module. Good for debug purposes.

          If unsure do not touch.

config SECURITY_MEDUSA_TESTING
	bool "MEDUSA Test Support"
	depends on KUNIT

config SECURITY_MEDUSA_MONITOR_KTHREADS
	bool "Monitor kernel threads"
	default n
	help
	  If set, kernel threads are monitored by Medusa LSM.
	  By default, this functionality is turned off.

config SECURITY_MEDUSA_HOOKS_TASK_KILL
	bool "Enable LSM hook task_kill"
	default y
	help
	  If set, enables task_kill LSM security hook.

config SECURITY_MEDUSA_KILL_RESCHEDULING
	bool "Enable rescheduling in task_kill LSM hook"
	depends on SECURITY_MEDUSA_HOOKS_TASK_KILL
	imply PREEMPT_CPU
	imply LOCKDEP
	default n
	help
	  If set, turns on PREEMPT_CPU and LOCKDEP to enable rescheduling in
	  the task_kill LSM hook. Rescheduling is possible only in specific
	  cases of signal sending (e.g. when sending a signal to a single
	  process, not a group) and serves only for security context
	  initialization of the sender/receiver. So this feature is suitable
	  for debugging purposes only.

	  If unsure, say N.

config SECURITY_MEDUSA_FUCK_HASH_TABLE_SIZE
	int "FUCK Number of hash table buckets (exponent)"
	# read default value from Medusa's config.h, if any; otherwise set default to 3
	default $(shell,grep -E "#define CONFIG_MEDUSA_FUCK_HASH_TABLE_SIZE [0-9]+" ./security/medusa/include/l3/config.h | grep -o -E "[0-9]+" || echo 3)
        range 0 8
	help
	  Determines the number of hash table buckets (exponent) the FUCK hash
	  table stored in inode_security has.
	  Increasing the size should help in cases where there are many files
	  being protected against FUCK attack.

# All of the options must have a matching elif branch in file
# include/l2/kobject_fuck_hash.h
choice SECURITY_MEDUSA_HASH_NAME_CHOICE
	prompt "FUCK Hashing function"
	help
	  Select a hashing function to be used within the FUCK module.

	  The selected hashing function must be marked as builtin in the
	  Cryptographic API section, otherwise the build will fail.

config SECURITY_MEDUSA_FUCK_BLAKE2B_256
	bool "Blake2b-256"
	depends on CRYPTO_BLAKE2B=y
	help
	  According to www.blake2.net: A cryptographic hash function faster
	  than MD5, SHA-1, SHA-2 and SHA-3, yet is at least as secure as the
	  latest standard SHA-3.
	  Optimized for 64-bit platforms. Produces 32 bytes long digests.

config SECURITY_MEDUSA_FUCK_BLAKE2B_512
	bool "Blake2b-512"
	depends on CRYPTO_BLAKE2B=y
	help
	  According to www.blake2.net: A cryptographic hash function faster
	  than MD5, SHA-1, SHA-2 and SHA-3, yet is at least as secure as the
	  latest standard SHA-3.
	  Optimized for 64-bit platforms. Produces 64 bytes long digests.

config SECURITY_MEDUSA_FUCK_BLAKE2S_256
	bool "Blake2s-256"
	depends on CRYPTO_BLAKE2S=y
	help
	  According to www.blake2.net: A cryptographic hash function faster
	  than MD5, SHA-1, SHA-2 and SHA-3, yet is at least as secure as the
	  latest standard SHA-3.
	  Optimized for 8- to 32-bit platforms. Produces 32 bytes long digests.

config SECURITY_MEDUSA_FUCK_SHA2_256
	bool "SHA2-256"
	depends on CRYPTO_SHA256=y
	help
	  Cryptograhpically secure

config SECURITY_MEDUSA_FUCK_SHA2_512
	bool "SHA2-512"
	depends on CRYPTO_SHA512=y
	help
	  Cryptographically secure. Usually faster than SHA256 on 64 bit machines

config SECURITY_MEDUSA_FUCK_SHA3_256
	bool "SHA3-256"
	depends on CRYPTO_SHA3=y
	help
	  Slower than SHA-2 algorithms, but more secure. Choose if you want more
	  protection than SHA-2 offers.

config SECURITY_MEDUSA_FUCK_SHA3_512
	bool "SHA3-512"
	depends on CRYPTO_SHA3=y
	help
	  Slower than SHA-2 algorithms, but more secure. Choose if you want more
	  protection than SHA-2 offers.

endchoice # SECURITY_MEDUSA_HASH_NAME_CHOICE

endif # SECURITY_MEDUSA_MET_DEPENDENCIES
```

## security/medusa/testing/Kconfig
```kconfig
#source "testing/l1/Kconfig"
#source "testing/l2/Kconfig"
source "security/medusa/testing/l3/Kconfig"
#source "testing/l4/Kconfig"
```
